const
  ERR_UNSUPPORTED_METHOD = 'Unsupported method.';
  ERR_INVALID_PARAMETER = 'Invalid parameter';
  ERR_INVALID_PARAMETER_VALUE = 'Invalid parameter value';
  ERR_INVALID_QUERY = 'Invalid Query or data not found';
  ERR_DATA_NOT_FOUND = 'Data not found';
  ERR_NODE_NOT_FOUND = 'Node not found.';
  ERR_NOT_PERMITTED = 'Not Permitted';
  ERR_FARM_NOT_FOUND = 'Farm not found';
  ERR_STATION_NOT_FOUND = 'Station not found';
  ERR_STATION_SCHEDULE_FAILED = 'Failed save schedule';

  ERR_AUTH_INVALID = 'Invalid username or password';
  ERR_AUTH_UNAUTHORIZED = 'Unauthorized access';

  INFO_DEVICE_CHECKID = 'Check your device ID';
  TEMPERATURE_KEY = 'suhu';
  HUMIDITY_KEY = 'kelembaban';

